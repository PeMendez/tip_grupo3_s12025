#include <DHT.h>
#include <SPI.h>
#include <Wire.h>
#include <Adafruit_GFX.h>
#include <Adafruit_SH110X.h>
#include <WiFi.h>
#include <PubSubClient.h>

#define DHTPIN 26
#define DHTTYPE DHT11

#define I2C_ADDRESS 0x3C // Dirección I2C del display
#define SCREEN_WIDTH 128
#define SCREEN_HEIGHT 64
#define OLED_RESET -1

DHT dht(DHTPIN, DHTTYPE);
Adafruit_SH1106G display(SCREEN_WIDTH, SCREEN_HEIGHT, &Wire, OLED_RESET);

const unsigned char logo[] PROGMEM = {
	// 'logo mono v2, 128x64px
	0x00, 0x00, 0x00, 0x00, 0x00, 0x00, 0x00, 0x00, 0x00, 0x00, 0x00, 0x00, 0x00, 0x00, 0x00, 0x00, 
	0x00, 0x00, 0x00, 0x00, 0x00, 0x00, 0x00, 0x00, 0x00, 0x00, 0x00, 0x00, 0x00, 0x00, 0x00, 0x00, 
	0x00, 0x00, 0x00, 0x00, 0x00, 0x00, 0x00, 0x00, 0x00, 0x00, 0x00, 0x00, 0x00, 0x00, 0x00, 0x00, 
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	0x00, 0x00, 0x00, 0x00, 0x00, 0x00, 0x00, 0x00, 0x00, 0x00, 0x00, 0x00, 0x00, 0x00, 0x00, 0x00
};

float tempHistory[5] = {24.0F, NAN, NAN, NAN, NAN}; // Historial de temperaturas
int tempIndex = 0;
int startTime;

// Configuración de WiFi y MQTT
const char* ssid = "Rengo-AP";
const char* password = "Acm27pts"; //Santo y seña por ahora hardcoded
const char* mqttBroker = "test.mosquitto.org";
const int mqttPort = 1883;
const char* topic = "neohub/unconfigured";

WiFiClient espClient;
PubSubClient mqttClient(espClient);

void showLogo() {
  display.clearDisplay();
  display.drawBitmap(0, 0, logo, 128, 64, SH110X_WHITE);
  display.display();
}

void connect_wifi(){
	// Conexión a WiFi
  Serial.println("Conectando a WiFi...");
  WiFi.begin(ssid, password);
  while (WiFi.status() != WL_CONNECTED) {
    delay(500);
    Serial.print(".");
  }
  Serial.println("\nWiFi conectado!");
}

void connect_mqtt(){
	// Configuración del cliente MQTT
  mqttClient.setServer(mqttBroker, mqttPort);

  // Generar un Client ID único usando la MAC
  uint8_t mac[6];
  WiFi.macAddress(mac);
  String clientId = "Temp-" + String(mac[4], HEX) + String(mac[5], HEX);
  mqttClient.connect(clientId.c_str());

  if (mqttClient.connected()) {
    Serial.println("Conectado al broker MQTT!");
  } else {
    Serial.println("Fallo al conectar al broker MQTT.");
  }
}

void setup() {
  Serial.begin(115200);
  dht.begin();

  // Inicializar la pantalla OLED
  if (!display.begin(I2C_ADDRESS, OLED_RESET)) {
    Serial.println(F("Error al iniciar el display OLED"));
    while (1);
  }
  showLogo();
	connect_wifi();
	connect_mqtt();
  startTime = millis();
}

void loop() {
  float temp = dht.readTemperature();
  float humidity = dht.readHumidity();
  float sendTemp = temp;

  // Guardar el valor en el array circular
  tempHistory[tempIndex] = temp;
  tempIndex = (tempIndex + 1) % 5; // Mantener el índice dentro de 0-4
/*
  Serial.print("Temp: ");
  Serial.print(temp);
  Serial.print(" C. ");
  Serial.print("Humidity: ");
  Serial.print(humidity);
  Serial.println("%.");
*/
  // Buscar el último valor válido en el historial
  float lastValidTemp = temp;
  for (int i = 0; i < 5; i++) {
    int idx = (tempIndex - 1 - i + 5) % 5; // Retroceder en el buffer circular
    if (!isnan(tempHistory[idx])) {
      lastValidTemp = tempHistory[idx];
      break;
    }
  }

  if(!mqttClient.connected()){
    connect_mqtt();
  }

  if (millis() - startTime < 3000) {
    return;  // Esperamos sin hacer nada visible
  }

  display.clearDisplay();

  if (isnan(lastValidTemp)) {
    // Si no hay valores válidos, mostrar error
    display.setTextSize(2);
    display.setTextColor(SH110X_WHITE);
    display.setCursor(5, 20);
    display.print("Esperando");
    display.setCursor(25, 45);
    display.print("sensor");
  } else {
    // Mostrar la temperatura en grande
    display.setTextSize(2);
    display.setTextColor(SH110X_WHITE);
    display.setCursor(35, 15);
    display.print(lastValidTemp, 1);
    display.print(" C");

//    if(lastValidTemp != sendTemp){
    Serial.println("Enviando nueva temp.");

    mqttClient.publish(topic,String(lastValidTemp).c_str());
//      sendTemp = lastValidTemp;
//    }

    // Mostrar la humedad en más pequeño
    display.setTextSize(1);
    display.setCursor(35, 45);
    display.print("Humedad: ");
    display.print(humidity, 0);
    display.print("%");
  }
  display.display();
  delay(2000); // Actualizar cada 2 segundos
}
