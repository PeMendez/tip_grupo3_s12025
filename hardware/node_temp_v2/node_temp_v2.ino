#include <DHT.h>
#include <SPI.h>
#include <Wire.h>
#include <Adafruit_GFX.h>
#include <Adafruit_SH110X.h>
#include <WiFi.h>
#include <PubSubClient.h>

#define DHTPIN 26
#define DHTTYPE DHT11
#define I2C_ADDRESS 0x3C
#define SCREEN_WIDTH 128
#define SCREEN_HEIGHT 64
#define OLED_RESET -1

DHT dht(DHTPIN, DHTTYPE);
Adafruit_SH1106G display(SCREEN_WIDTH, SCREEN_HEIGHT, &Wire, OLED_RESET);

const unsigned char logo[] PROGMEM = {

	// 'logo mono v2, 128x64px
	0x00, 0x00, 0x00, 0x00, 0x00, 0x00, 0x00, 0x00, 0x00, 0x00, 0x00, 0x00, 0x00, 0x00, 0x00, 0x00, 
	0x00, 0x00, 0x00, 0x00, 0x00, 0x00, 0x00, 0x00, 0x00, 0x00, 0x00, 0x00, 0x00, 0x00, 0x00, 0x00, 
	0x00, 0x00, 0x00, 0x00, 0x00, 0x00, 0x00, 0x00, 0x00, 0x00, 0x00, 0x00, 0x00, 0x00, 0x00, 0x00, 
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	0x00, 0x00, 0x00, 0x00, 0x00, 0x00, 0x00, 0x00, 0x00, 0x00, 0x00, 0x00, 0x00, 0x00, 0x00, 0x00
};
float tempHistory[5] = {NAN, NAN, NAN, NAN, NAN};
int tempIndex = 0;
unsigned long startTime, dbgTime;
float lastSentTemp = NAN;
bool initial_flag = true;

// Configuración de WiFi y MQTT
const char* ssid = "Rengo-AP";
const char* password = "Acm27pts"; //Santo y seña por ahora hardcoded
const char* mqttBroker = "test.mosquitto.org";
const int mqttPort = 1883;
const char* topic = "unq-temperature";

WiFiClient espClient;
PubSubClient mqttClient(espClient);

void showLogo() {
  display.clearDisplay();
  display.drawBitmap(0, 0, logo, 128, 64, SH110X_WHITE);
  display.display();
}

void displayTemp(float temp, float hum){
    display.clearDisplay();
    display.setTextSize(2);
    display.setTextColor(SH110X_WHITE);
    display.setCursor(35, 15);
    display.print(temp, 1);
    display.print(" C");

    display.setTextSize(1);
    display.setCursor(35, 45);
    display.print("Humedad: ");
    display.print(hum, 0);
    display.print("%");
    display.display();
}

void connect_wifi() {
  Serial.println("Conectando a WiFi...");
  WiFi.begin(ssid, password);
  while (WiFi.status() != WL_CONNECTED) {
    delay(500);
    Serial.print(".");
  }
  Serial.println("\nWiFi conectado!");
}

void connect_mqtt() {
  mqttClient.setServer(mqttBroker, mqttPort);
  uint8_t mac[6];
  WiFi.macAddress(mac);
  String clientId = "Temp-" + String(mac[4], HEX) + String(mac[5], HEX);
  mqttClient.connect(clientId.c_str());

  if (mqttClient.connected()) {
    Serial.println("Conectado al broker MQTT!");
  } else {
    Serial.println("Fallo al conectar al broker MQTT.");
  }
}

void setup() {
  Serial.begin(115200);
  dht.begin();

  if (!display.begin(I2C_ADDRESS, OLED_RESET)) {
    Serial.println(F("Error al iniciar el display OLED"));
    while (1);
  }

  showLogo();
  connect_wifi();
  connect_mqtt();

  startTime = millis();
  dbgTime = millis();
}

void loop() {
  if (!mqttClient.connected()) {
    connect_mqtt();
  }
  mqttClient.loop();

  float temp = dht.readTemperature();
  float humidity = dht.readHumidity();
  float lastValidTemp = NAN;
  
  // Guardar el valor en el array circular
  tempHistory[tempIndex] = temp;
  tempIndex = (tempIndex + 1) % 5;

  // Obtener último valor válido
  
  for (int i = 0; i < 5; i++) {
    int idx = (tempIndex - 1 - i + 5) % 5;
    if (!isnan(tempHistory[idx])) {
      lastValidTemp = tempHistory[idx];
      break;
    }
  }

  // Esperar los 3 segundos iniciales (mostrar solo logo)
  if (millis() - startTime < 3000){
    return;
  }

  if(millis() - dbgTime > 2000){
    Serial.print(lastValidTemp);
    Serial.print(" - ");
    Serial.println(lastSentTemp);
    dbgTime = millis();
  }

  if (initial_flag && !isnan(lastValidTemp)){
    Serial.println("Temperatura inicial.");
    //Ver si es la primera vez que va a displayear temperatura
    displayTemp(lastValidTemp,humidity);
    // Enviar por MQTT
    char tempBuffer[10];
    dtostrf(lastValidTemp, 4, 1, tempBuffer);
    mqttClient.publish(topic, tempBuffer);
    lastSentTemp = lastValidTemp;
    initial_flag = false;
  }
  // Solo actualiza si cambió al menos 0.1 °C
  if (!isnan(lastValidTemp) && fabs(lastValidTemp - lastSentTemp) >= 0.1) {
    Serial.println("Temperatura cambió, actualizando pantalla y MQTT.");
    displayTemp(lastValidTemp, humidity);

    // Enviar por MQTT
    char tempBuffer[10];
    dtostrf(lastValidTemp, 4, 1, tempBuffer);
    mqttClient.publish(topic, tempBuffer);

    lastSentTemp = lastValidTemp;
  }
  if (isnan(lastValidTemp)) {
    // Si no hay valores válidos, mostrar mensaje
    Serial.println("Chequear el sensor.");
    display.setTextSize(2);
    display.setTextColor(SH110X_WHITE);
    display.setCursor(5, 20);
    display.print("Esperando");
    display.setCursor(25, 45);
    display.print("sensor");
  }
}
